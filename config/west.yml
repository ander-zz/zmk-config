## config/west.yml
```yaml
manifest:
  remotes:
    - name: zmkfirmware
      url-base: https://github.com/zmkfirmware
    - name: zmk-locales-base
      url-base: https://github.com/ander-zz
    - name: urob
      url-base: https://github.com/ander-zz
  projects:
    - name: zmk
      remote: zmkfirmware
      revision: main
      import: app/west.yml
    - name: zmk-locales
      remote: zmk-locales-base
      revision: main
    - name: zmk-helpers
      remote: urob
      revision: main

  self:
    path: config
```
